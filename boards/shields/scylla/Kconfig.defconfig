## boards/shields/scylla/Kconfig.defconfig
```kconfig
if SHIELD_SCYLLA_RIGHT

# Name must be less than 16 characters long!
config ZMK_KEYBOARD_NAME
    default "SCYLLA-TEST"

endif

if SHIELD_SCYLLA_LEFT || SHIELD_SCYLLA_RIGHT

config ZMK_SPLIT
    default y

endif
```
